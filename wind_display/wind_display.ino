// ===== WIND DISPLAY — ESP32-2432S028 ("Cheap Yellow Display", 2USB variant) =====
// A separate board with its own ESP32 and a 2.8" 320x240 screen, mounted in the enclosure.
// It shows the station's live frame, and it gets that frame over ONE wire: the station
// writes its /api/data JSON, one line at a time, out of GPIO23 (UART1, 115200 8N1, 5 Hz),
// and this board reads it on IO27 (connector CN1). No WiFi, no pairing, nothing to
// configure — see "DISPLAY LINK" in esp32_wind_station.ino for why it is not WiFi.
//
// Board identity, because two very different things are sold as "TPM408-2.8": this is
// NOT a bare SPI module. TPM408-2.8 is only the marking of the LCD glass. The board has
// ESP32-WROOM-32, a CH340C USB bridge, Type-C + micro-USB, an ST7789 panel on HSPI,
// an XPT2046 resistive touch controller on its own SPI pins, an LDR, an RGB LED and a TF
// slot. The single-USB variant uses ILI9341 instead — see PANEL_* below if colours or
// the orientation come out wrong.
//
// Wiring (full version with photos-of-connectors in DISPLAY.md):
//   station GPIO23 (breadboard 18j)  ->  CN1 "IO27"         signal, the only data wire
//   station "+" rail, right half      ->  P1  "VIN"          ~4.7 V bus, after SW1
//   station "-" rail, right half      ->  P1  "GND"          the only ground
//   CN1 "IO22" <-> CN1 "GND"          optional sealed button: wakes the backlight
//   CN1 "3.3V", P1 "TX"/"RX"          NOT connected
//
// Libraries: LovyanGFX (>= 1.2), ArduinoJson (7.x). Fonts come from display_fonts.h,
// generated by gen_display_fonts.py — the built-in ones have no Cyrillic.
// Build:  arduino-cli compile --fqbn esp32:esp32:esp32 wind_display
// Flash:  over USB (CH340C). This board has no electrolytic on EN, so auto-reset works
//         and `arduino-cli upload` is fine here — unlike the station.

#include <LovyanGFX.hpp>
#include <ArduinoJson.h>
#include <time.h>
#include "display_fonts.h"
#include "glass_bg.h"   // generated by gen_glass.py — two 320x240 glass backgrounds

// ===== PANEL — the three things to flip if the test screen looks wrong =====
// The boot screen shows three bars labelled КРАСНЫЙ / ЗЕЛЁНЫЙ / СИНИЙ on black, plus an
// arrow into the top-left corner. It exists to settle these constants in one glance:
//   - red and blue swapped              -> flip PANEL_BGR
//   - background white, colours negated -> flip PANEL_INVERT
//   - arrow not in the top-left corner  -> DISPLAY_ROTATION 1 <-> 3
// Defaults are the CYD 2USB profile (ST7789, BGR order, no inversion) from the
// witnessmenow/ESP32-Cheap-Yellow-Display DisplayConfig/CYD2USB setup.
#define PANEL_BGR         true
#define PANEL_INVERT      false
#define DISPLAY_ROTATION  1        // landscape; 3 = landscape turned 180°

// ===== PINS (fixed by the board, listed so nobody reuses them) =====
#define PIN_LINK_RX      27   // CN1 IO27 <- station GPIO23
#define PIN_WAKE_BTN     22   // CN1 IO22, button to GND (INPUT_PULLUP); also on P3
#define PIN_BOOT_BTN      0   // on-board BOOT: held at power-up = touch calibration
#define PIN_LDR          34   // on-board light sensor, input-only ADC1
#define PIN_LED_R         4   // on-board RGB LED, active LOW — kept dark in a box
#define PIN_LED_G        16
#define PIN_LED_B        17
// GPIO21 is the backlight and it is also printed on connector P3. Never wire anything to
// P3's IO21: the PWM on it is what dims the screen.

// ===== LINK =====
const unsigned long LINK_BAUD = 115200;   // must match DISPLAY_BAUD in the station
// A frame is ~800 bytes. 1536 leaves room for every optional field the station may add,
// while a line longer than this is garbage by definition and is dropped whole.
const size_t LINK_LINE_MAX = 1536;
// No frame for this long = "no data". The station sends 5 per second, so three seconds is
// fifteen frames missed in a row — no single hiccup, the wire or the station is down.
const unsigned long STALE_MS = 3000;
// Bench mode: 1 = draw a synthetic wind instead of waiting for the station. For checking
// the screen before any wire is connected. Frames arriving on the link or on USB still win.
#define DEMO_WITHOUT_STATION 0

// ===== TIME =====
// The station sends UTC epoch (only once SNTP has run: timeValid). The display turns it
// into local time itself. POSIX TZ string for Kyiv: EET, EEST from last Sunday of March
// 03:00 to last Sunday of October 04:00. Change for another zone, the station does not care.
#define DISPLAY_TZ "EET-2EEST,M3.5.0/3,M10.5.0/4"

// ===== BACKLIGHT =====
// Most of this board's current is the backlight (tens of mA at full), so it is the one
// thing worth managing. Touch or the wake button turns it back on.
const unsigned long BACKLIGHT_TIMEOUT_MS = 300000;  // 5 min idle -> off; 0 = always on
// A strong gust turns the screen on by itself: the moment somebody would want to look.
// Same threshold as the station's red LED.
const float    WAKE_ON_GUST_MS = 15.0;
const uint8_t  BL_MIN = 24;    // darkest usable level in a dark room
const uint8_t  BL_MAX = 255;
// Auto-brightness from the LDR. On the CYD the reading goes DOWN as light goes UP and the
// stock divider saturates at 0 in ordinary daylight, so the useful range is at the dark
// end. These two numbers are starting points: the raw value is printed to Serial every
// 5 s — note it in the dark and in daylight and put them here.
#define AUTO_BRIGHTNESS 1
const int LDR_BRIGHT_RAW = 50;     // at or below: full brightness
const int LDR_DARK_RAW   = 1500;   // at or above: BL_MIN

// ===== TOUCH CALIBRATION =====
// Firmware never writes NVS (same rule as the station), so calibration is a constant.
// To get one: hold BOOT while powering up, touch the four corner marks, and copy the line
// it prints to Serial over this one, with TOUCH_CAL_VALID set to true.
#define TOUCH_CAL_VALID false
uint16_t touchCal[8] = {0, 0, 0, 0, 0, 0, 0, 0};

// ===== DISPLAY DRIVER =====
class LGFX : public lgfx::LGFX_Device {
  lgfx::Panel_ST7789  panel;
  lgfx::Bus_SPI       bus;
  lgfx::Light_PWM     light;
  lgfx::Touch_XPT2046 touch;

public:
  LGFX() {
    {
      auto cfg = bus.config();
      cfg.spi_host    = SPI2_HOST;   // HSPI
      cfg.spi_mode    = 0;
      // 55 MHz is what the CYD profiles run with. If the picture shows sparkles or torn
      // lines on long wires inside a box, 40 MHz costs nothing visible at this frame rate.
      cfg.freq_write  = 55000000;
      cfg.freq_read   = 16000000;
      cfg.spi_3wire   = false;
      cfg.use_lock    = true;
      cfg.dma_channel = SPI_DMA_CH_AUTO;
      cfg.pin_sclk    = 14;
      cfg.pin_mosi    = 13;
      cfg.pin_miso    = 12;
      cfg.pin_dc      = 2;
      bus.config(cfg);
      panel.setBus(&bus);
    }
    {
      auto cfg = panel.config();
      cfg.pin_cs           = 15;
      cfg.pin_rst          = -1;   // tied to EN on this board
      cfg.pin_busy         = -1;
      cfg.panel_width      = 240;
      cfg.panel_height     = 320;
      cfg.offset_x         = 0;
      cfg.offset_y         = 0;
      cfg.offset_rotation  = 0;
      cfg.dummy_read_pixel = 8;
      cfg.dummy_read_bits  = 1;
      cfg.readable         = true;
      cfg.invert           = PANEL_INVERT;
      cfg.rgb_order        = PANEL_BGR;
      cfg.dlen_16bit       = false;
      cfg.bus_shared       = false;  // touch has its own pins, SD is unused
      panel.config(cfg);
    }
    {
      auto cfg = light.config();
      cfg.pin_bl      = 21;
      cfg.invert      = false;
      cfg.freq        = 44100;   // above hearing: some backlight drivers sing at 1-5 kHz
      cfg.pwm_channel = 7;
      light.config(cfg);
      panel.setLight(&light);
    }
    {
      auto cfg = touch.config();
      // Raw ADC window of a typical CYD. Only used until a calibration is pasted in.
      cfg.x_min           = 300;
      cfg.x_max           = 3900;
      cfg.y_min           = 200;
      cfg.y_max           = 3700;
      cfg.pin_int         = 36;   // PENIRQ: lets getTouch() skip the SPI read when idle
      cfg.bus_shared      = false;
      cfg.offset_rotation = 0;
      cfg.spi_host        = SPI3_HOST;  // VSPI, on the touch controller's own pins
      cfg.freq            = 1000000;
      cfg.pin_sclk        = 25;
      cfg.pin_mosi        = 32;
      cfg.pin_miso        = 39;
      cfg.pin_cs          = 33;
      touch.config(cfg);
      panel.setTouch(&touch);
    }
    setPanel(&panel);
  }
};

LGFX lcd;

// ===== FONTS =====
// Loaded once into our own font objects and switched with setFont() — lcd.loadFont()
// would re-parse the glyph table on every switch and keeps only one font at a time.
struct VlwFont {
  lgfx::PointerWrapper data;
  lgfx::VLWfont        font;
  bool load(const uint8_t* arr) { data.set(arr); return font.loadFont(&data); }
};
VlwFont fText, fTextB, fMid, fBig;

// ===== TYPES =====
// Up here, above every function, on purpose: the Arduino builder inserts prototypes for
// all functions before the first one it finds, and a prototype that mentions a type
// defined further down does not compile.

// One line being assembled from a serial port.
struct LineReader {
  char   buf[LINK_LINE_MAX + 1];
  size_t len = 0;
  bool   overflow = false;   // current line is too long: discard until '\n'
};

// Where a screen region is drawn: its sprite, or the panel itself if the sprite could not
// be allocated, plus the y the region starts at on that canvas.
struct Canvas { lgfx::LovyanGFX* g; int oy; bool sprite; };

// ===== COLOURS (RGB888 — LovyanGFX treats uint32_t as 24-bit colour) =====
constexpr uint32_t C_BG     = 0x0B1220u;
constexpr uint32_t C_TEXT   = 0xE8EEF6u;
constexpr uint32_t C_DIM    = 0x8394ABu;
constexpr uint32_t C_FAINT  = 0x4A5A73u;
constexpr uint32_t C_ACCENT = 0x38BDF8u;
constexpr uint32_t C_GREEN  = 0x4ADE80u;
constexpr uint32_t C_YELLOW = 0xFACC15u;
constexpr uint32_t C_RED    = 0xF87171u;
constexpr uint32_t C_ORANGE = 0xFB923Cu;

// Wind colour by the station's own LED thresholds, so the screen and the LEDs agree.
uint32_t windColor(float v) {
  if (v > 15.0f) return C_RED;
  if (v > 5.0f)  return C_YELLOW;
  return C_TEXT;
}

// ===== STATION STATE =====
// Everything the screen shows, parsed out of the last good frame. "has*" flags follow the
// station's contract: an absent key means "nothing to say" and the row is not drawn at
// all, which is different from a key that is present and empty.
struct Station {
  float    speed = 0, gust = 0, speedMax = 30;
  bool     dirPresent = false;
  float    direction = 0;
  bool     batteryPresent = false;
  float    battery = 0;
  int      batteryPercent = -1;
  char     chargeState[16] = "";
  char     powerSource[12] = "";
  bool     adcError = false;
  bool     staConnected = false;
  char     staIp[20] = "";
  bool     hasPpp = false;
  char     pppState[12] = "";
  bool     hasNet = false;
  char     netOperator[24] = "";
  int      netRssi = 0;
  bool     hasCloud = false;
  bool     cloudConnected = false;
  char     cloudError[40] = "";
  uint32_t uptime = 0;
  char     resetReason[12] = "";
  bool     timeValid = false;
  uint32_t epoch = 0;
  uint32_t loopMax = 0;
  float    speedMv = 0, speedZeroMv = 0;
} st;

unsigned long lastFrameMs  = 0;     // millis() of the last GOOD frame; 0 = never
unsigned long framesOk     = 0;
unsigned long framesBad    = 0;     // lines that were not valid JSON
unsigned long linkBytes    = 0;     // every byte seen on IO27 — 0 means wiring, not software

// ===== LINE READERS =====
// Two sources, same parser: the wire from the station, and the USB console — so a frame
// copied from /api/data can be pasted into a serial terminal to test the screen on a desk.
LineReader rdLink, rdUsb;

bool parseFrame(const char* line, size_t len);

void pumpLines(Stream& port, LineReader& r, bool countBytes) {
  // Bounded: at most one ring's worth per pass, so a flood cannot starve drawing.
  int budget = 2048;
  while (port.available() && budget-- > 0) {
    char c = (char)port.read();
    if (countBytes) linkBytes++;
    if (c == '\r') continue;
    if (c == '\n') {
      if (!r.overflow && r.len > 0) {
        r.buf[r.len] = 0;
        if (parseFrame(r.buf, r.len)) framesOk++; else framesBad++;
      } else if (r.overflow) {
        framesBad++;
      }
      r.len = 0;
      r.overflow = false;
      continue;
    }
    if (r.overflow) continue;
    if (r.len >= LINK_LINE_MAX) { r.overflow = true; continue; }
    r.buf[r.len++] = c;
  }
}

static void copyStr(char* dst, size_t cap, const char* src) {
  if (!src) { dst[0] = 0; return; }
  strncpy(dst, src, cap - 1);
  dst[cap - 1] = 0;
}

bool parseFrame(const char* line, size_t len) {
  if (line[0] != '{') return false;   // console noise, boot garbage, a wrong baud rate
  JsonDocument doc;
  if (deserializeJson(doc, line, len)) return false;
  if (!doc["speed"].is<float>()) return false;   // valid JSON, but not a station frame

  st.speed          = doc["speed"] | 0.0f;
  st.gust           = doc["gust"] | st.speed;
  st.speedMax       = doc["speedMax"] | 30.0f;
  st.dirPresent     = doc["dirPresent"] | false;
  st.direction      = doc["direction"] | 0.0f;
  st.batteryPresent = doc["batteryPresent"] | false;
  st.battery        = doc["battery"] | 0.0f;
  st.batteryPercent = doc["batteryPercent"].isNull() ? -1 : (int)(doc["batteryPercent"] | -1);
  copyStr(st.chargeState, sizeof(st.chargeState), doc["chargeState"] | "");
  copyStr(st.powerSource, sizeof(st.powerSource), doc["powerSource"] | "");
  st.adcError       = doc["adcError"] | false;
  st.staConnected   = doc["staConnected"] | false;
  copyStr(st.staIp, sizeof(st.staIp), doc["staIp"] | "");
  st.hasPpp         = doc["pppState"].is<const char*>();
  copyStr(st.pppState, sizeof(st.pppState), doc["pppState"] | "");
  st.hasNet         = doc["netOperator"].is<const char*>();
  copyStr(st.netOperator, sizeof(st.netOperator), doc["netOperator"] | "");
  st.netRssi        = doc["netRssi"] | 0;
  st.hasCloud       = doc["cloudConnected"].is<bool>();
  st.cloudConnected = doc["cloudConnected"] | false;
  copyStr(st.cloudError, sizeof(st.cloudError), doc["cloudError"] | "");
  st.uptime         = doc["uptime"] | 0UL;
  copyStr(st.resetReason, sizeof(st.resetReason), doc["resetReason"] | "");
  st.timeValid      = doc["timeValid"] | false;
  st.epoch          = doc["epoch"] | 0UL;
  st.loopMax        = doc["loopMax"] | 0UL;
  st.speedMv        = doc["speedMv"] | 0.0f;
  st.speedZeroMv    = doc["speedZeroMv"] | 0.0f;
  lastFrameMs = millis();
  if (lastFrameMs == 0) lastFrameMs = 1;   // 0 is reserved for "never"
  return true;
}

bool dataFresh() { return lastFrameMs && millis() - lastFrameMs < STALE_MS; }

// ===== HISTORY (10 minutes, one point per 2 s) =====
const int      HIST_N       = 300;
const unsigned long HIST_STEP_MS = 2000;
float histAvg[HIST_N], histMax[HIST_N];
int   histHead = 0;             // next slot to write
float bucketSum = 0, bucketMax = 0;
int   bucketCount = 0;
unsigned long bucketStart = 0;

void historySample() {
  if (dataFresh()) {
    bucketSum += st.speed;
    bucketCount++;
    if (st.speed > bucketMax) bucketMax = st.speed;
  }
  if (millis() - bucketStart < HIST_STEP_MS) return;
  bucketStart = millis();
  // A bucket with no fresh frame is a GAP, not a zero: calm and "no data" must not look
  // the same on the graph, for the same reason the station never reports 0 for absent.
  histAvg[histHead] = bucketCount ? bucketSum / bucketCount : NAN;
  histMax[histHead] = bucketCount ? bucketMax : NAN;
  histHead = (histHead + 1) % HIST_N;
  bucketSum = 0; bucketMax = 0; bucketCount = 0;
}

// ===== TEXT HELPERS =====
static const char* BEAUFORT_RU[13] = {
  "Штиль", "Тихий", "Лёгкий", "Слабый", "Умеренный", "Свежий", "Сильный",
  "Крепкий", "Очень крепкий", "Шторм", "Сильный шторм", "Жестокий шторм", "Ураган"};
// Upper bounds of Beaufort 0..11 in m/s (WMO); anything above is 12.
static const float BEAUFORT_MAX[12] = {0.2f, 1.5f, 3.3f, 5.4f, 7.9f, 10.7f,
                                       13.8f, 17.1f, 20.7f, 24.4f, 28.4f, 32.6f};

int beaufort(float v) {
  for (int i = 0; i < 12; i++) if (v <= BEAUFORT_MAX[i]) return i;
  return 12;
}

const char* ballWord(int n) {
  if (n % 10 == 1 && n % 100 != 11) return "балл";
  if (n % 10 >= 2 && n % 10 <= 4 && (n % 100 < 12 || n % 100 > 14)) return "балла";
  return "баллов";
}

const char* compass8(float deg) {
  static const char* N[8] = {"С", "СВ", "В", "ЮВ", "Ю", "ЮЗ", "З", "СЗ"};
  int i = (int)((fmodf(deg + 22.5f + 360.0f, 360.0f)) / 45.0f) & 7;
  return N[i];
}

const char* chargeWord(const char* s) {
  if (!strcmp(s, "charging"))    return "заряжается";
  if (!strcmp(s, "full"))        return "заряжена";
  if (!strcmp(s, "discharging")) return "разряжается";
  if (!strcmp(s, "absent"))      return "нет банки";
  return s;
}

void fmtDuration(char* out, size_t cap, uint32_t s) {
  if (s < 3600)       snprintf(out, cap, "%lu мин", (unsigned long)(s / 60));
  else if (s < 86400) snprintf(out, cap, "%lu ч %lu мин", (unsigned long)(s / 3600), (unsigned long)(s % 3600 / 60));
  else                snprintf(out, cap, "%lu д %lu ч", (unsigned long)(s / 86400), (unsigned long)(s % 86400 / 3600));
}

// ===== SPRITES =====
// Every region is drawn off-screen and pushed in one go, so values change without the
// flicker of fill-then-draw. 16-bit, ~150 kB in total — fine with the radio off. If an
// allocation ever fails, that region draws straight to the panel (flickers, still works).
const int W = 320;
const int TOP_H = 24, HERO_Y = 24, HERO_H = 128, GRAPH_Y = 152, GRAPH_H = 72, STAT_Y = 224, STAT_H = 16;
LGFX_Sprite sTop(&lcd), sHero(&lcd), sGraph(&lcd), sStat(&lcd);

// The glass background of the current page (glass_bg.h). Everything that does not move —
// wallpaper, blurred panels, rim light, shadows, the scale track — is baked in on the PC
// by gen_glass.py; the board only copies the matching slice under each region and draws
// numbers on top. Layout below must match PANELS_* / TRACK in gen_glass.py.
const uint16_t* pageBg = GLASS_BG_MAIN;

// Region starts as its slice of the background. The array is already swap565 (the byte
// order the panel takes over SPI), so this is a straight copy with no conversion.
Canvas beginRegion(LGFX_Sprite& s, int y, int h) {
  auto src = (const lgfx::swap565_t*)(pageBg + y * W);
  if (s.getBuffer()) { s.pushImage(0, 0, W, h, src); return {&s, 0, true}; }
  lcd.pushImage(0, y, W, h, src);
  return {&lcd, y, false};
}

// Whole page background at once — page switch and first draw.
void pushPageBg() {
  lcd.pushImage(0, 0, W, GLASS_H, (const lgfx::swap565_t*)pageBg);
}

// Text on glass gets a 1 px dark drop shadow: the background under it is a busy blurred
// gradient, and without one the dim labels sink into the lighter parts of the panel.
const uint32_t C_SHADOW = 0x000814u;
void glassText(lgfx::LovyanGFX* g, const char* s, int x, int y, uint32_t col) {
  g->setTextColor(C_SHADOW);
  g->drawString(s, x, y + 1);
  g->setTextColor(col);
  g->drawString(s, x, y);
}

void endRegion(Canvas& c, LGFX_Sprite& s, int y) {
  if (c.sprite) s.pushSprite(0, y);
}

// ===== BACKLIGHT =====
uint8_t blLevel = BL_MAX;          // what the LDR asks for
bool    blOn = true;
unsigned long lastActivity = 0;
float   ldrEma = -1;

void backlightWake() {
  lastActivity = millis();
  if (!blOn) { blOn = true; lcd.setBrightness(blLevel); }
}

void serviceBacklight() {
#if AUTO_BRIGHTNESS
  int raw = analogRead(PIN_LDR);
  ldrEma = ldrEma < 0 ? raw : ldrEma * 0.95f + raw * 0.05f;   // no flicker on a passing shadow
  float t = (ldrEma - LDR_BRIGHT_RAW) / (float)(LDR_DARK_RAW - LDR_BRIGHT_RAW);
  t = t < 0 ? 0 : (t > 1 ? 1 : t);
  blLevel = (uint8_t)(BL_MAX - t * (BL_MAX - BL_MIN));
#endif
  if (BACKLIGHT_TIMEOUT_MS && blOn && millis() - lastActivity > BACKLIGHT_TIMEOUT_MS) {
    blOn = false;
    lcd.setBrightness(0);
    return;
  }
  if (blOn) lcd.setBrightness(blLevel);
}

// ===== DRAWING: TOP BAR =====
// Sits on the glass capsule (4..316 x 3..24). Links are a coloured dot plus a plain label:
// outlined badges were fine on flat colour, on glass the outline fights the rim light.
void drawBadge(lgfx::LovyanGFX* g, int& x, int y, const char* label, uint32_t col) {
  g->setFont(&fText.font);
  int w = g->textWidth(label) + 10;
  g->fillSmoothCircle(x + 3, y + 13, 3, col);
  g->setTextDatum(textdatum_t::middle_left);
  glassText(g, label, x + 9, y + 13, C_TEXT);
  x += w + 6;
}

void drawTopBar() {
  Canvas c = beginRegion(sTop, 0, TOP_H);
  auto g = c.g;
  int y = c.oy;

  // Clock: station epoch advanced by our own millis since the frame arrived.
  char buf[24];
  if (st.timeValid && st.epoch && lastFrameMs) {
    time_t t = (time_t)st.epoch + (millis() - lastFrameMs) / 1000;
    struct tm lt;
    localtime_r(&t, &lt);
    strftime(buf, sizeof(buf), "%H:%M", &lt);
  } else {
    strcpy(buf, "--:--");   // "don't know", never 1970 — same rule as the station's epoch 0
  }
  g->setFont(&fTextB.font);
  g->setTextDatum(textdatum_t::middle_left);
  glassText(g, buf, 12, y + 13, C_TEXT);

  // Links. A badge is drawn only when the frame says the link exists in this build.
  int x = 66;
  bool fresh = dataFresh();
  drawBadge(g, x, y, "Wi-Fi", fresh && st.staConnected ? C_GREEN : C_FAINT);
  if (st.hasPpp) {
    uint32_t col = C_FAINT;
    if (fresh && !strcmp(st.pppState, "online")) col = C_GREEN;
    else if (fresh && (!strcmp(st.pppState, "attaching") || !strcmp(st.pppState, "dialing"))) col = C_YELLOW;
    else if (fresh && !strcmp(st.pppState, "failed")) col = C_RED;
    drawBadge(g, x, y, "4G", col);
  }
  if (st.hasCloud) drawBadge(g, x, y, "Облако", fresh && st.cloudConnected ? C_GREEN : C_FAINT);

  // Battery: icon + percent, or a word when there is no pack.
  int bx = W - 40, by = y + 7;
  if (st.batteryPresent && st.batteryPercent >= 0) {
    int p = st.batteryPercent;
    uint32_t col = p > 60 ? C_GREEN : (p > 30 ? C_YELLOW : C_RED);
    g->drawRoundRect(bx, by, 26, 12, 3, C_DIM);
    g->fillRect(bx + 26, by + 3, 3, 6, C_DIM);
    g->fillRect(bx + 2, by + 2, (22 * p) / 100, 8, col);
    snprintf(buf, sizeof(buf), "%s%d%%", !strcmp(st.chargeState, "charging") ? "↑" : "", p);
    g->setFont(&fTextB.font);
    g->setTextDatum(textdatum_t::middle_right);
    glassText(g, buf, bx - 5, y + 13, col);
  } else if (lastFrameMs) {
    g->setFont(&fText.font);
    g->setTextDatum(textdatum_t::middle_right);
    glassText(g, "нет банки", W - 12, y + 13, C_DIM);
  }
  endRegion(c, sTop, 0);
}

// ===== DRAWING: HERO (speed, gust, Beaufort, scale) =====
// On the big glass panel (6..314 x 28..150). The scale track is baked into the background
// at GLASS_TRACK_*; only the fill, the marks and the gust tick are drawn here.
void drawHero() {
  Canvas c = beginRegion(sHero, HERO_Y, HERO_H);
  auto g = c.g;
  int y = c.oy;
  bool fresh = dataFresh();
  char buf[40];

  if (!lastFrameMs) {
    // Never had a frame: say what is known about the wire instead of drawing zeros.
    g->setFont(&fMid.font);
    g->setTextDatum(textdatum_t::middle_center);
    glassText(g, "Жду станцию…", W / 2, y + 40, C_TEXT);
    g->setFont(&fText.font);
    if (linkBytes == 0) {
      glassText(g, "по проводу не пришло ни байта", W / 2, y + 78, C_DIM);
      glassText(g, "проверь провод GPIO23 → IO27 и землю", W / 2, y + 98, C_DIM);
    } else {
      snprintf(buf, sizeof(buf), "байты идут (%lu), кадров нет", linkBytes);
      glassText(g, buf, W / 2, y + 78, C_DIM);
      glassText(g, "не та скорость порта или не та прошивка", W / 2, y + 98, C_DIM);
    }
    endRegion(c, sHero, HERO_Y);
    return;
  }

  uint32_t col = fresh ? windColor(st.speed) : C_FAINT;
  snprintf(buf, sizeof(buf), "%.1f", st.speed);
  // One size for every reading: 84 px is the largest at which "28.8" (the digits are
  // monospaced, so that is the worst case, 207 px) fits between the panel edge and "м/с".
  // Right edge fixed at 224 so the unit never moves; the gust block above it ends at y ~60,
  // the unit starts at ~70, so they share the column without touching.
  g->setFont(&fBig.font);
  g->setTextDatum(textdatum_t::baseline_right);
  glassText(g, buf, 224, y + 92, col);
  g->setFont(&fMid.font);
  g->setTextDatum(textdatum_t::baseline_left);
  glassText(g, "м/с", 228, y + 92, fresh ? C_DIM : C_FAINT);

  // Gust, top right — inset from the panel's rounded corner.
  g->setFont(&fText.font);
  g->setTextDatum(textdatum_t::top_right);
  glassText(g, "порыв", W - 18, y + 12, C_DIM);
  snprintf(buf, sizeof(buf), "%.1f", st.gust);
  g->setFont(&fMid.font);
  glassText(g, buf, W - 18, y + 30, fresh ? windColor(st.gust) : C_FAINT);

  // Beaufort + direction line.
  int b = beaufort(st.speed);
  snprintf(buf, sizeof(buf), "%d %s · %s", b, ballWord(b), BEAUFORT_RU[b]);
  g->setFont(&fTextB.font);
  g->setTextDatum(textdatum_t::baseline_left);
  glassText(g, buf, 18, y + 110, fresh ? C_TEXT : C_FAINT);
  if (st.dirPresent) {
    snprintf(buf, sizeof(buf), "%s %.0f°", compass8(st.direction), st.direction);
    g->setTextDatum(textdatum_t::baseline_right);
    glassText(g, buf, W - 18, y + 110, fresh ? C_TEXT : C_FAINT);
  }

  // Scale 0..speedMax: fill over the baked track, LED thresholds 5/15 as light marks,
  // gust as a tick.
  int sx = GLASS_TRACK_X, sw = GLASS_TRACK_W, sy = y + GLASS_TRACK_Y - HERO_Y, sh = GLASS_TRACK_H;
  float vmax = st.speedMax > 1 ? st.speedMax : 30;
  int fill = (int)(sw * fminf(st.speed / vmax, 1.0f));
  if (fill > 1) g->fillSmoothRoundRect(sx, sy, fill + 1, sh + 1, 3, col);
  for (float mark : {5.0f, 15.0f}) {
    int mx = sx + (int)(sw * mark / vmax);
    g->fillRectAlpha(mx, sy - 2, 1, sh + 4, 90, 0xFFFFFFu);
  }
  int gx = sx + (int)(sw * fminf(st.gust / vmax, 1.0f));
  g->fillRoundRect(gx - 1, sy - 3, 3, sh + 6, 1, fresh ? C_TEXT : C_FAINT);
  endRegion(c, sHero, HERO_Y);
}

// ===== DRAWING: GRAPH =====
// On the lower glass panel (6..314 x 155..222). Translucent white for grid and gust
// envelope: a fixed grey would be a different shade on every part of the gradient.
void drawGraph() {
  Canvas c = beginRegion(sGraph, GRAPH_Y, GRAPH_H);
  auto g = c.g;
  const int x0 = 16, w = W - 32, h = 56;
  int y0 = c.oy + 160 - GRAPH_Y;

  float vmax = 5;
  for (int i = 0; i < HIST_N; i++) if (!isnan(histMax[i]) && histMax[i] > vmax) vmax = histMax[i];
  vmax = ceilf(vmax / 5) * 5;   // round the scale to 5 m/s steps so it does not twitch

  for (float v = 5; v < vmax; v += 5) {
    int yy = y0 + h - 1 - (int)((h - 2) * v / vmax);
    g->fillRectAlpha(x0, yy, w, 1, 30, 0xFFFFFFu);
  }

  // Oldest on the left. 300 points onto w-2 columns: sampled, not averaged — a gust peak
  // skipped by the sampling still shows up in the envelope of its neighbours often enough,
  // and the numbers are on the details page anyway.
  const int n = w - 2;
  int prevY = -1;
  for (int i = 0; i < n; i++) {
    int k = (histHead + i * HIST_N / n) % HIST_N;
    int x = x0 + 1 + i;
    if (isnan(histAvg[k])) { prevY = -1; continue; }
    int ym = y0 + h - 1 - (int)((h - 2) * fminf(histMax[k] / vmax, 1.0f));
    int ya = y0 + h - 1 - (int)((h - 2) * fminf(histAvg[k] / vmax, 1.0f));
    if (ya > ym) g->fillRectAlpha(x, ym, 1, ya - ym + 1, 45, 0xFFFFFFu);
    uint32_t lc = windColor(histAvg[k]) == C_TEXT ? C_ACCENT : windColor(histAvg[k]);
    if (prevY >= 0) {
      g->drawLine(x - 1, prevY, x, ya, lc);       // 2 px line: 1 px vanishes on glass
      g->drawLine(x - 1, prevY + 1, x, ya + 1, lc);
    } else {
      g->fillRect(x, ya, 1, 2, lc);
    }
    prevY = ya;
  }

  char buf[12];
  snprintf(buf, sizeof(buf), "%.0f", vmax);
  g->setFont(&fText.font);
  g->setTextDatum(textdatum_t::top_left);
  glassText(g, "10 мин", x0 + 4, y0 + 2, C_DIM);
  g->setTextDatum(textdatum_t::top_right);
  glassText(g, buf, x0 + w - 4, y0 + 2, C_DIM);
  endRegion(c, sGraph, GRAPH_Y);
}

// ===== DRAWING: STATUS LINE =====
// Straight on the wallpaper, below the panels.
void drawStatus() {
  Canvas c = beginRegion(sStat, STAT_Y, STAT_H);
  auto g = c.g;
  int y = c.oy;
  char buf[64];
  uint32_t col = C_DIM;
  g->setFont(&fText.font);
  g->setTextDatum(textdatum_t::middle_left);
  if (lastFrameMs && !dataFresh()) {
    unsigned long age = (millis() - lastFrameMs) / 1000;
    snprintf(buf, sizeof(buf), "Нет данных от станции %lu с", age);
    col = C_RED;
  } else if (st.adcError) {
    snprintf(buf, sizeof(buf), "Ошибка датчика скорости");
    col = C_ORANGE;
  } else if (lastFrameMs) {
    const char* src = !strcmp(st.powerSource, "external") ? "внешнее" : "батарея";
    if (st.batteryPresent)
      snprintf(buf, sizeof(buf), "Питание: %s · %.2f В · %s", src, st.battery, chargeWord(st.chargeState));
    else
      snprintf(buf, sizeof(buf), "Питание: %s", src);
  } else {
    buf[0] = 0;
  }
  glassText(g, buf, 8, y + STAT_H / 2, col);
  // The hint goes only where it fits: a full power line is wider than half the screen
  // and the two used to print on top of each other.
  static const char* HINT = "тап → подробно";
  if (8 + g->textWidth(buf) + 12 + g->textWidth(HINT) <= W - 6) {
    g->setTextDatum(textdatum_t::middle_right);
    glassText(g, HINT, W - 6, y + STAT_H / 2, C_FAINT);
  }
  endRegion(c, sStat, STAT_Y);
}

// ===== DRAWING: DETAILS PAGE =====
// One tall glass panel (6..314 x 28..236). Drawn through the graph sprite in three bands
// of 72 px (24..240): each band starts as its slice of the background, every row is drawn
// into it and the sprite clips whatever falls outside. Three small pushes instead of one
// full-screen sprite, which would not fit in RAM next to the others.
void drawDetails() {
  const int rowH = 18, rowsY = 32;
  char v[64];
  struct Row { const char* k; String val; uint32_t col; };
  Row rows[11];
  int n = 0;
  bool fresh = dataFresh();

  if (st.batteryPresent)
    snprintf(v, sizeof(v), "%.2f В · %d %% · %s", st.battery, st.batteryPercent, chargeWord(st.chargeState));
  else
    snprintf(v, sizeof(v), "%s", chargeWord(st.chargeState));
  rows[n++] = {"Батарея", v, C_TEXT};
  rows[n++] = {"Питание", !strcmp(st.powerSource, "external") ? "внешнее" : "батарея", C_TEXT};
  rows[n++] = {"Wi-Fi дом", st.staConnected ? String("есть · ") + st.staIp : String("нет"),
               st.staConnected ? C_GREEN : C_DIM};
  if (st.hasPpp) {
    String s = st.pppState;
    if (st.hasNet) s += String(" · ") + st.netOperator + " " + st.netRssi + " дБм";
    rows[n++] = {"4G", s, !strcmp(st.pppState, "online") ? C_GREEN : C_DIM};
  }
  if (st.hasCloud)
    rows[n++] = {"Облако", st.cloudConnected ? String("на связи") : (st.cloudError[0] ? String(st.cloudError) : String("нет")),
                 st.cloudConnected ? C_GREEN : C_DIM};
  rows[n++] = {"Часы", st.timeValid ? "синхронизированы" : "не синхронизированы", st.timeValid ? C_TEXT : C_YELLOW};
  fmtDuration(v, sizeof(v), st.uptime);
  String up = v;
  if (st.resetReason[0] && strcmp(st.resetReason, "poweron")) up += String(" · ") + st.resetReason;
  rows[n++] = {"Аптайм", up, !strcmp(st.resetReason, "brownout") ? C_ORANGE : C_TEXT};
  snprintf(v, sizeof(v), "%.0f мВ (ноль %.0f)", st.speedMv, st.speedZeroMv);
  rows[n++] = {"Датчик", v, st.adcError ? C_ORANGE : C_TEXT};
  snprintf(v, sizeof(v), "%lu мс", (unsigned long)st.loopMax);
  rows[n++] = {"loopMax", v, st.loopMax > 20 ? C_YELLOW : C_TEXT};
  snprintf(v, sizeof(v), "%lu ок · %lu брак · %lu Б", framesOk, framesBad, linkBytes);
  rows[n++] = {"Провод", v, framesBad > framesOk / 10 + 3 ? C_YELLOW : C_TEXT};
  if (lastFrameMs) snprintf(v, sizeof(v), "%.1f с назад", (millis() - lastFrameMs) / 1000.0f);
  else snprintf(v, sizeof(v), "не было");
  rows[n++] = {"Кадр", v, fresh ? C_TEXT : C_RED};

  for (int band = TOP_H; band < GLASS_H; band += GRAPH_H) {
    Canvas c = beginRegion(sGraph, band, GRAPH_H);
    auto g = c.g;
    int dy = c.oy - band;   // screen y -> canvas y
    g->setFont(&fText.font);
    g->setTextDatum(textdatum_t::middle_left);
    for (int i = 0; i < n; i++) {
      int y = rowsY + i * rowH + dy;
      if (y + rowH < c.oy || y > c.oy + GRAPH_H) continue;   // not in this band
      if (i) g->fillRectAlpha(18, y, W - 36, 1, 18, 0xFFFFFFu);
      glassText(g, rows[i].k, 18, y + rowH / 2, C_DIM);
      glassText(g, rows[i].val.c_str(), 104, y + rowH / 2, rows[i].col);
    }
    endRegion(c, sGraph, band);
  }
}

// ===== BOOT TEST SCREEN =====
void drawTestScreen() {
  lcd.fillScreen(0x000000u);
  const char* names[3] = {"КРАСНЫЙ", "ЗЕЛЁНЫЙ", "СИНИЙ"};
  const uint32_t cols[3] = {0xFF0000u, 0x00FF00u, 0x0000FFu};
  lcd.setFont(&fTextB.font);
  lcd.setTextDatum(textdatum_t::middle_center);
  for (int i = 0; i < 3; i++) {
    int x = 16 + i * 100;
    lcd.fillRect(x, 60, 88, 90, cols[i]);
    lcd.setTextColor(0xFFFFFFu);
    lcd.drawString(names[i], x + 44, 165);
  }
  // Arrow into the top-left corner: says the rotation is what it should be.
  lcd.fillTriangle(2, 2, 26, 2, 2, 26, 0xFFFFFFu);
  lcd.setFont(&fText.font);
  lcd.setTextDatum(textdatum_t::top_left);
  lcd.drawString("← верх-лево", 30, 4);
  lcd.setTextDatum(textdatum_t::middle_center);
  lcd.setTextColor(0xAAAAAAu);
  lcd.drawString("цвет не тот → PANEL_BGR, фон белый → PANEL_INVERT", W / 2, 205);
  lcd.drawString("стрелка не в углу → DISPLAY_ROTATION", W / 2, 224);
}

// ===== TOUCH CALIBRATION =====
void runTouchCalibration() {
  lcd.fillScreen(C_BG);
  lcd.setFont(&fTextB.font);
  lcd.setTextColor(C_TEXT);
  lcd.setTextDatum(textdatum_t::middle_center);
  lcd.drawString("Калибровка касания", W / 2, 100);
  lcd.setFont(&fText.font);
  lcd.drawString("коснись меток в углах по очереди", W / 2, 124);
  delay(1500);
  lcd.calibrateTouch(touchCal, 0xFFFFFFu, 0x000000u, 16);
  Serial.println("\n=== Touch calibration: paste over touchCal in wind_display.ino ===");
  Serial.print("uint16_t touchCal[8] = {");
  for (int i = 0; i < 8; i++) Serial.printf("%u%s", touchCal[i], i < 7 ? ", " : "};\n");
  Serial.println("...and set TOUCH_CAL_VALID to true.");
}

// ===== DEMO =====
#if DEMO_WITHOUT_STATION
void demoFrame() {
  static unsigned long last = 0;
  if (millis() - last < 200 || (lastFrameMs && millis() - lastFrameMs < 5000 && framesOk > 0 && linkBytes > 0)) return;
  last = millis();
  float t = millis() / 1000.0f;
  st.speed = fmaxf(0, 6 + 4 * sinf(t / 7) + 2.5f * sinf(t * 1.7f));
  st.gust = fmaxf(st.gust * 0.999f, st.speed);
  st.batteryPresent = true; st.battery = 3.95f; st.batteryPercent = 78;
  strcpy(st.chargeState, "discharging"); strcpy(st.powerSource, "battery");
  st.hasPpp = true; strcpy(st.pppState, "online"); st.hasCloud = true; st.cloudConnected = true;
  st.uptime = millis() / 1000;
  lastFrameMs = millis();
}
#endif

// ===== SETUP =====
void setup() {
  // Before Serial.begin: the UART divisor comes from the CPU clock. 80 MHz is plenty for
  // a 5 Hz screen and roughly halves the CPU's share of the current. The radio is never
  // started (no WiFi.h, no BT), which is the other half.
  setCpuFrequencyMhz(80);
  Serial.begin(115200);
  Serial.println("\n=== Wind Display (CYD) ===");

  // The link. Only RX is assigned: the core falls back to its default UART2 pins only
  // when BOTH are negative, so tx = -1 leaves every other pin alone. A ring bigger than
  // a frame so a slow draw pass never costs characters.
  Serial2.setRxBufferSize(4096);
  Serial2.begin(LINK_BAUD, SERIAL_8N1, PIN_LINK_RX, -1);

  pinMode(PIN_WAKE_BTN, INPUT_PULLUP);
  pinMode(PIN_BOOT_BTN, INPUT_PULLUP);
  for (int p : {PIN_LED_R, PIN_LED_G, PIN_LED_B}) { pinMode(p, OUTPUT); digitalWrite(p, HIGH); }
  analogReadResolution(12);

  setenv("TZ", DISPLAY_TZ, 1);
  tzset();

  for (int i = 0; i < HIST_N; i++) { histAvg[i] = NAN; histMax[i] = NAN; }

  lcd.init();
  lcd.setRotation(DISPLAY_ROTATION);
  lcd.setBrightness(BL_MAX);
  if (!fText.load(FONT_TEXT) || !fTextB.load(FONT_TEXT_B) || !fMid.load(FONT_MID) || !fBig.load(FONT_BIG))
    Serial.println("Font load FAILED — regenerate display_fonts.h");

  if (digitalRead(PIN_BOOT_BTN) == LOW) runTouchCalibration();
  else if (TOUCH_CAL_VALID) lcd.setTouchCalibrate(touchCal);

  drawTestScreen();
  delay(2500);

  for (auto* s : {&sTop, &sHero, &sGraph, &sStat}) s->setColorDepth(16);
  bool ok = sTop.createSprite(W, TOP_H) && sHero.createSprite(W, HERO_H) &&
            sGraph.createSprite(W, GRAPH_H) && sStat.createSprite(W, STAT_H);
  Serial.printf("Sprites %s, heap free %lu, largest block %lu\n", ok ? "OK" : "PARTIAL (direct draw)",
                (unsigned long)ESP.getFreeHeap(), (unsigned long)heap_caps_get_largest_free_block(MALLOC_CAP_8BIT));
  pushPageBg();
  lastActivity = millis();
  bucketStart = millis();
}

// ===== LOOP =====
int page = 0;                  // 0 = main, 1 = details
bool touchWasDown = false;
unsigned long lastDraw = 0, lastSlowDraw = 0, lastLdrLog = 0, lastBlService = 0;
unsigned long drawnFrameMs = 1;   // lastFrameMs the screen currently reflects

void loop() {
  pumpLines(Serial2, rdLink, true);
  pumpLines(Serial, rdUsb, false);
#if DEMO_WITHOUT_STATION
  demoFrame();
#endif
  historySample();

  // Input: a tap wakes a dark screen and does nothing else; on a lit screen it flips pages.
  int32_t tx, ty;
  bool down = lcd.getTouch(&tx, &ty) || digitalRead(PIN_WAKE_BTN) == LOW;
  if (down && !touchWasDown) {
    if (!blOn) backlightWake();
    else {
      backlightWake();
      page ^= 1;
      pageBg = page ? GLASS_BG_DETAILS : GLASS_BG_MAIN;
      pushPageBg();
      drawnFrameMs = 0;   // force a full redraw of the new page
    }
  }
  touchWasDown = down;

  if (dataFresh() && st.gust >= WAKE_ON_GUST_MS) backlightWake();

  if (millis() - lastBlService > 100) { serviceBacklight(); lastBlService = millis(); }

  // Draw on a new frame, and once a second regardless (clock, data age, staleness).
  bool newFrame = lastFrameMs != drawnFrameMs;
  bool slowTick = millis() - lastSlowDraw >= 1000;
  if (blOn && (newFrame || slowTick) && millis() - lastDraw >= 100) {
    lastDraw = millis();
    if (slowTick) lastSlowDraw = millis();
    drawTopBar();
    if (page == 0) {
      if (newFrame || slowTick) drawHero();
      if (slowTick) drawGraph();
      drawStatus();
    } else if (slowTick || drawnFrameMs == 0) {
      drawDetails();
    }
    drawnFrameMs = lastFrameMs;
  }

  if (millis() - lastLdrLog > 5000) {
    lastLdrLog = millis();
    Serial.printf("ldr=%d bl=%u%s  frames ok=%lu bad=%lu bytes=%lu\n", analogRead(PIN_LDR), blLevel,
                  blOn ? "" : " (off)", framesOk, framesBad, linkBytes);
  }
}
